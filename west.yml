## west.yml
```yaml
# Copyright (c) 2021 Nordic Semiconductor ASA
# SPDX-License-Identifier: Apache-2.0

manifest:
  self:
    west-commands: scripts/west-commands.yml

  remotes:
    - name: maxd
      url-base: https://github.com/maxd-nordic

  projects:
    - name: nrf
      remote: maxd
      repo-path: sdk-nrf
      revision: thingy91x_board
      import: true
```
